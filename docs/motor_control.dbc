// =============================================================================
// Motor Control CAN FD DBC - YTM32 Sensorless FOC
// Generated by .scripts/generate_dbc.py using cantools
// CAN FD: 500 kbit/s arbitration, 2 Mbit/s data, 64-byte payload
// PE Clock: 120 MHz (Peripheral Clock)
// =============================================================================

VERSION "1.0"

NS_ :

BS_:

BU_: MCU PC

BO_ 384 MCU_MotorStatus1: 64 MCU
 SG_ HfiRippleMetric : 416|16@1+ (0.001,0) [0|0] "A" Vector__XXX
 SG_ HfiConfidence : 400|16@1+ (0.001,0) [0|0] "" Vector__XXX
 SG_ HfiAngle : 384|16@1+ (0.0001,0) [0|0] "rad" Vector__XXX
 SG_ HfiFallbackReason : 376|8@1+ (1,0) [0|0] "" Vector__XXX
 SG_ HfiFlags : 368|8@1+ (1,0) [0|0] "" Vector__XXX
 SG_ AngleMonBemfMag : 352|16@1+ (1,0) [0|0] "" Vector__XXX
 SG_ AngleMonSpeedRadS : 336|16@1- (0.1,0) [0|0] "rad/s" Vector__XXX
 SG_ AngleMonAngle : 320|16@1+ (0.0001,0) [0|0] "rad" Vector__XXX
 SG_ AngleMonFlags : 312|8@1+ (1,0) [0|0] "" Vector__XXX
 SG_ Timestamp : 280|32@1+ (1,0) [0|0] "ms" Vector__XXX
 SG_ DutyW : 264|16@1+ (0.0001,0) [0|0] "" Vector__XXX
 SG_ DutyV : 248|16@1+ (0.0001,0) [0|0] "" Vector__XXX
 SG_ DutyU : 232|16@1+ (0.0001,0) [0|0] "" Vector__XXX
 SG_ StartupRetryCount : 224|8@1+ (1,0) [0|0] "" Vector__XXX
 SG_ PhaseCurrentC : 208|16@1- (0.01,0) [0|0] "A" Vector__XXX
 SG_ PhaseCurrentB : 192|16@1- (0.01,0) [0|0] "A" Vector__XXX
 SG_ PhaseCurrentA : 176|16@1- (0.01,0) [0|0] "A" Vector__XXX
 SG_ ElecSpeedRadS : 160|16@1- (0.1,0) [0|0] "rad/s" Vector__XXX
 SG_ ElecAngle : 144|16@1+ (0.0001,0) [0|0] "rad" Vector__XXX
 SG_ TargetRpm : 128|16@1- (0.5,0) [0|0] "rpm" Vector__XXX
 SG_ IqTarget : 112|16@1- (0.01,0) [0|0] "A" Vector__XXX
 SG_ IdTarget : 96|16@1- (0.01,0) [0|0] "A" Vector__XXX
 SG_ IqMeas : 80|16@1- (0.01,0) [0|0] "A" Vector__XXX
 SG_ IdMeas : 64|16@1- (0.01,0) [0|0] "A" Vector__XXX
 SG_ BusVoltage : 48|16@1+ (0.01,0) [0|0] "V" Vector__XXX
 SG_ MechanicalRpm : 32|16@1- (0.5,0) [0|0] "rpm" Vector__XXX
 SG_ Flags : 24|8@1+ (1,0) [0|0] "" Vector__XXX
 SG_ ControlMode : 16|8@1+ (1,0) [0|0] "" Vector__XXX
 SG_ FaultCode : 8|8@1+ (1,0) [0|0] "" Vector__XXX
 SG_ State : 0|8@1+ (1,0) [0|0] "" Vector__XXX

BO_ 385 MCU_MotorStatus2: 64 MCU
 SG_ IdentLambdaVs : 472|32@1+ (1,0) [0|0] "Vs" Vector__XXX
 SG_ IdentLsH : 440|32@1+ (1,0) [0|0] "H" Vector__XXX
 SG_ IdentRsOhm : 408|32@1+ (1,0) [0|0] "Ohm" Vector__XXX
 SG_ IdentProgress : 400|8@1+ (1,0) [0|0] "%" Vector__XXX
 SG_ IdentPhase : 392|8@1+ (1,0) [0|0] "" Vector__XXX
 SG_ BemfPhaseSeq : 384|8@1- (1,0) [0|0] "" Vector__XXX
 SG_ BemfDetectedRpm : 368|16@1- (1,0) [0|0] "rpm" Vector__XXX
 SG_ BemfCrossingCount : 352|16@1+ (1,0) [0|0] "" Vector__XXX
 SG_ BemfComRaw : 336|16@1+ (1,0) [0|0] "" Vector__XXX
 SG_ BemfWRaw : 320|16@1+ (1,0) [0|0] "" Vector__XXX
 SG_ BemfVRaw : 304|16@1+ (1,0) [0|0] "" Vector__XXX
 SG_ BemfURaw : 288|16@1+ (1,0) [0|0] "" Vector__XXX
 SG_ ChipTemperature : 272|16@1- (0.1,0) [0|0] "degC" Vector__XXX
 SG_ PcbTemperature : 256|16@1- (0.1,0) [0|0] "degC" Vector__XXX
 SG_ StallDivCount : 240|16@1+ (1,0) [0|0] "" Vector__XXX
 SG_ ObsLockResidualRad : 224|16@1- (0.0001,0) [0|0] "rad" Vector__XXX
 SG_ StateTimeMs : 192|32@1+ (1,0) [0|0] "ms" Vector__XXX
 SG_ ClosedLoopBlend : 176|16@1+ (0.0001,0) [0|0] "" Vector__XXX
 SG_ OpenLoopSpeedRadS : 160|16@1- (0.1,0) [0|0] "rad/s" Vector__XXX
 SG_ OpenLoopAngle : 144|16@1+ (0.0001,0) [0|0] "rad" Vector__XXX
 SG_ FwIdTarget : 128|16@1- (0.01,0) [0|0] "A" Vector__XXX
 SG_ VoltModRatio : 112|16@1+ (0.0001,0) [0|0] "" Vector__XXX
 SG_ IqPiIntegrator : 96|16@1- (0.01,0) [0|0] "V" Vector__XXX
 SG_ IdPiIntegrator : 80|16@1- (0.01,0) [0|0] "V" Vector__XXX
 SG_ SpeedPiIntegrator : 64|16@1- (0.01,0) [0|0] "A" Vector__XXX
 SG_ PhaseErrorRad : 48|16@1- (0.0001,0) [0|0] "rad" Vector__XXX
 SG_ PLLSpeedRadS : 32|16@1- (0.1,0) [0|0] "rad/s" Vector__XXX
 SG_ ObserverFluxVs : 16|16@1+ (1e-06,0) [0|0] "Vs" Vector__XXX
 SG_ ObserverAngle : 0|16@1+ (0.0001,0) [0|0] "rad" Vector__XXX

BO_ 512 PC_MotorCommand: 64 PC
 SG_ CmdReserved : 72|56@1+ (1,0) [0|0] "" Vector__XXX
 SG_ CmdRpmRamp : 56|16@1+ (1,0) [0|0] "rpm/s" Vector__XXX
 SG_ CmdTargetIqA : 40|16@1- (0.01,0) [0|0] "A" Vector__XXX
 SG_ CmdTargetRpm : 24|16@1- (0.5,0) [0|0] "rpm" Vector__XXX
 SG_ CmdDirection : 16|8@1- (1,0) [0|0] "" Vector__XXX
 SG_ CmdControlMode : 8|8@1+ (1,0) [0|0] "" Vector__XXX
 SG_ CmdEnable : 0|8@1+ (1,0) [0|0] "" Vector__XXX

BO_ 513 PC_CalibWrite: 64 PC
 SG_ CalibApply : 232|8@1+ (1,0) [0|0] "" Vector__XXX
 SG_ CalibFwThreshold : 216|16@1+ (0.0001,0) [0|0] "" Vector__XXX
 SG_ CalibAlignCurrentA : 200|16@1+ (0.01,0) [0|0] "A" Vector__XXX
 SG_ CalibOpenLoopIqA : 184|16@1+ (0.01,0) [0|0] "A" Vector__XXX
 SG_ CalibMaxIqA : 168|16@1+ (0.01,0) [0|0] "A" Vector__XXX
 SG_ CalibPllKi : 136|32@1+ (1,0) [0|0] "" Vector__XXX
 SG_ CalibPllKp : 104|32@1+ (1,0) [0|0] "" Vector__XXX
 SG_ CalibObsGain : 72|32@1+ (1,0) [0|0] "" Vector__XXX
 SG_ CalibSpeedKi : 40|32@1+ (1,0) [0|0] "" Vector__XXX
 SG_ CalibSpeedKp : 8|32@1+ (1,0) [0|0] "" Vector__XXX
 SG_ CalibSelector : 0|8@1+ (1,0) [0|0] "" Vector__XXX

BO_ 386 MCU_CalibReadback: 64 MCU
 SG_ ActiveHfiAlignHoldMs : 472|16@1+ (1,0) [0|0] "ms" Vector__XXX
 SG_ ActiveHfiPolarityPulseCount : 464|8@1+ (1,0) [0|0] "" Vector__XXX
 SG_ ActiveHfiPolarityV : 448|16@1+ (0.01,0) [0|0] "V" Vector__XXX
 SG_ ActiveHfiConfidenceMin : 432|16@1+ (0.001,0) [0|0] "" Vector__XXX
 SG_ ActiveHfiInjectV : 416|16@1+ (0.01,0) [0|0] "V" Vector__XXX
 SG_ ActiveHfiPulsePairs : 408|8@1+ (1,0) [0|0] "" Vector__XXX
 SG_ ActiveHfiCandidateCount : 400|8@1+ (1,0) [0|0] "" Vector__XXX
 SG_ ActiveHfiFlags : 392|8@1+ (1,0) [0|0] "" Vector__XXX
 SG_ WaveformSampleCount : 376|16@1+ (1,0) [0|0] "" Vector__XXX
 SG_ WaveformState : 368|8@1+ (1,0) [0|0] "" Vector__XXX
 SG_ ActiveCurrentIqKi : 336|32@1+ (1,0) [0|0] "V/A/s" Vector__XXX
 SG_ ActiveCurrentIqKp : 304|32@1+ (1,0) [0|0] "V/A" Vector__XXX
 SG_ ActiveCurrentIdKi : 272|32@1+ (1,0) [0|0] "V/A/s" Vector__XXX
 SG_ ActiveCurrentIdKp : 240|32@1+ (1,0) [0|0] "V/A" Vector__XXX
 SG_ ActiveRpmRamp : 224|16@1+ (1,0) [0|0] "rpm/s" Vector__XXX
 SG_ ActiveFwThreshold : 208|16@1+ (0.0001,0) [0|0] "" Vector__XXX
 SG_ ActiveAlignCurrentA : 192|16@1+ (0.01,0) [0|0] "A" Vector__XXX
 SG_ ActiveOpenLoopIqA : 176|16@1+ (0.01,0) [0|0] "A" Vector__XXX
 SG_ ActiveMaxIqA : 160|16@1+ (0.01,0) [0|0] "A" Vector__XXX
 SG_ ActivePllKi : 128|32@1+ (1,0) [0|0] "" Vector__XXX
 SG_ ActivePllKp : 96|32@1+ (1,0) [0|0] "" Vector__XXX
 SG_ ActiveObsGain : 64|32@1+ (1,0) [0|0] "" Vector__XXX
 SG_ ActiveSpeedKi : 32|32@1+ (1,0) [0|0] "" Vector__XXX
 SG_ ActiveSpeedKp : 0|32@1+ (1,0) [0|0] "" Vector__XXX

BO_ 387 MCU_MotorStatus3: 64 MCU
 SG_ WfCh6_ElecAngle : 256|32@1+ (1,0) [0|0] "rad" Vector__XXX
 SG_ WfCh5_Iq : 224|32@1+ (1,0) [0|0] "A" Vector__XXX
 SG_ WfCh4_Id : 192|32@1+ (1,0) [0|0] "A" Vector__XXX
 SG_ WfCh3_Vbus : 160|32@1+ (1,0) [0|0] "V" Vector__XXX
 SG_ WfCh2_Ic : 128|32@1+ (1,0) [0|0] "A" Vector__XXX
 SG_ WfCh1_Ib : 96|32@1+ (1,0) [0|0] "A" Vector__XXX
 SG_ WfCh0_Ia : 64|32@1+ (1,0) [0|0] "A" Vector__XXX
 SG_ WfDecimation : 40|8@1+ (1,0) [0|0] "" Vector__XXX
 SG_ WfTriggerSource : 32|8@1+ (1,0) [0|0] "" Vector__XXX
 SG_ WfTotalSamples : 16|16@1+ (1,0) [0|0] "" Vector__XXX
 SG_ WfSampleIndex : 0|16@1+ (1,0) [0|0] "" Vector__XXX

BO_ 514 PC_TestCommand: 64 PC
 SG_ TcHfiAlignHoldMs : 360|16@1+ (1,0) [0|0] "ms" Vector__XXX
 SG_ TcHfiPolarityPulseCount : 352|8@1+ (1,0) [0|0] "" Vector__XXX
 SG_ TcHfiPolarityV : 336|16@1+ (0.01,0) [0|0] "V" Vector__XXX
 SG_ TcHfiConfidenceMin : 320|16@1+ (0.001,0) [0|0] "" Vector__XXX
 SG_ TcHfiInjectV : 304|16@1+ (0.01,0) [0|0] "V" Vector__XXX
 SG_ TcHfiPulsePairs : 296|8@1+ (1,0) [0|0] "" Vector__XXX
 SG_ TcHfiCandidateCount : 288|8@1+ (1,0) [0|0] "" Vector__XXX
 SG_ TcHfiEnable : 280|8@1+ (1,0) [0|0] "" Vector__XXX
 SG_ TcStepDecimation : 272|8@1+ (1,0) [0|0] "" Vector__XXX
 SG_ TcStepInjectIdA : 240|32@1+ (1,0) [0|0] "A" Vector__XXX
 SG_ TcStepPostSamples : 224|16@1+ (1,0) [0|0] "" Vector__XXX
 SG_ TcStepPreSamples : 208|16@1+ (1,0) [0|0] "" Vector__XXX
 SG_ TcIdentIqStepA : 176|32@1+ (1,0) [0|0] "A" Vector__XXX
 SG_ TcIdentIqMaxA : 144|32@1+ (1,0) [0|0] "A" Vector__XXX
 SG_ TcIdentIqMinA : 112|32@1+ (1,0) [0|0] "A" Vector__XXX
 SG_ TcIdentTestCurrentA : 80|32@1+ (1,0) [0|0] "A" Vector__XXX
 SG_ TcIdentTargetRpm : 48|32@1+ (1,0) [0|0] "rpm" Vector__XXX
 SG_ TcIdentPolePairs : 40|8@1+ (1,0) [0|0] "" Vector__XXX
 SG_ TcTriggerSource : 32|8@1+ (1,0) [0|0] "" Vector__XXX
 SG_ TcDecimation : 24|8@1+ (1,0) [0|0] "" Vector__XXX
 SG_ TcNSamples : 8|16@1+ (1,0) [0|0] "" Vector__XXX
 SG_ TcCommandType : 0|8@1+ (1,0) [0|0] "" Vector__XXX

CM_ BU_ MCU "YTM32 Motor Controller ECU";
CM_ BU_ PC "Test PC / Calibration Tool";
CM_ BO_ 384 "Core motor telemetry: state, fault, RPM, Idq, Vbus, phase currents, PWM duty, timestamp, and passive angle-monitor summary. Cycle: 10ms.";
CM_ SG_ 384 HfiRippleMetric "Best synchronous HFI ripple metric";
CM_ SG_ 384 HfiConfidence "HFI final confidence metric [0..1]";
CM_ SG_ 384 HfiAngle "HFI estimated initial electrical angle";
CM_ SG_ 384 HfiFallbackReason "0=none,1=disabled,2=vbus,3=confidence,4=repeatability,5=polarity";
CM_ SG_ 384 HfiFlags "Bit0=active, Bit1=angle_valid, Bit2=used";
CM_ SG_ 384 AngleMonBemfMag "Passive BEMF vector magnitude in ADC counts";
CM_ SG_ 384 AngleMonSpeedRadS "Passive BEMF monitored electrical speed";
CM_ SG_ 384 AngleMonAngle "Passive BEMF monitored electrical angle";
CM_ SG_ 384 AngleMonFlags "Bit0=active, Bit1=valid, Bit2=direction positive";
CM_ SG_ 384 Timestamp "System tick milliseconds";
CM_ SG_ 384 DutyW "Phase W PWM duty [0..1]";
CM_ SG_ 384 DutyV "Phase V PWM duty [0..1]";
CM_ SG_ 384 DutyU "Phase U PWM duty [0..1]";
CM_ SG_ 384 StartupRetryCount "Startup retry attempts";
CM_ SG_ 384 PhaseCurrentC "Phase C current";
CM_ SG_ 384 PhaseCurrentB "Phase B current";
CM_ SG_ 384 PhaseCurrentA "Phase A current";
CM_ SG_ 384 ElecSpeedRadS "Electrical speed";
CM_ SG_ 384 ElecAngle "Electrical angle [0, 2pi)";
CM_ SG_ 384 TargetRpm "Ramped speed target";
CM_ SG_ 384 IqTarget "Commanded q-axis current target";
CM_ SG_ 384 IdTarget "Commanded d-axis current target";
CM_ SG_ 384 IqMeas "Measured q-axis current";
CM_ SG_ 384 IdMeas "Measured d-axis current";
CM_ SG_ 384 BusVoltage "DC bus voltage";
CM_ SG_ 384 MechanicalRpm "Estimated mechanical speed";
CM_ SG_ 384 Flags "Bit0=Enabled, Bit1=ObsLocked, Bit2=Direction(1=fwd)";
CM_ SG_ 384 ControlMode "0=Speed, 1=Current";
CM_ SG_ 384 FaultCode "Active fault code (0=None)";
CM_ SG_ 384 State "Motor state machine (0=Stop..8=Fault, 9=AngleMonitor, 10=HFI_IPD)";
CM_ BO_ 385 "Observer/PI diagnostics, temperature, BEMF, param ident telemetry. Cycle: 10ms.";
CM_ SG_ 385 IdentLambdaVs "Identified PM flux linkage";
CM_ SG_ 385 IdentLsH "Identified stator inductance";
CM_ SG_ 385 IdentRsOhm "Identified stator resistance";
CM_ SG_ 385 IdentProgress "Current phase progress 0-100";
CM_ SG_ 385 IdentPhase "0=Idle,1=Rs,2=Ls,3=Lambda,4=Complete,5=DragFail,6=Error";
CM_ SG_ 385 BemfPhaseSeq "Phase sequence: +1=fwd, -1=rev, 0=unknown";
CM_ SG_ 385 BemfDetectedRpm "BEMF-detected mechanical RPM";
CM_ SG_ 385 BemfCrossingCount "Zero-crossing count";
CM_ SG_ 385 BemfComRaw "BEMF COM raw ADC count";
CM_ SG_ 385 BemfWRaw "BEMF W raw ADC count";
CM_ SG_ 385 BemfVRaw "BEMF V raw ADC count";
CM_ SG_ 385 BemfURaw "BEMF U raw ADC count";
CM_ SG_ 385 ChipTemperature "MCU die temperature from TMU";
CM_ SG_ 385 PcbTemperature "PCB board temperature";
CM_ SG_ 385 StallDivCount "Consecutive stall divergence count";
CM_ SG_ 385 ObsLockResidualRad "Observer lock residual angle";
CM_ SG_ 385 StateTimeMs "Time in current state";
CM_ SG_ 385 ClosedLoopBlend "Closed-loop blend factor [0..1]";
CM_ SG_ 385 OpenLoopSpeedRadS "Open-loop forced speed";
CM_ SG_ 385 OpenLoopAngle "Forced open-loop angle";
CM_ SG_ 385 FwIdTarget "Field weakening d-axis current";
CM_ SG_ 385 VoltModRatio "|Vab|/Vbus modulation ratio";
CM_ SG_ 385 IqPiIntegrator "Q-axis current PI integrator";
CM_ SG_ 385 IdPiIntegrator "D-axis current PI integrator";
CM_ SG_ 385 SpeedPiIntegrator "Speed PI integrator state";
CM_ SG_ 385 PhaseErrorRad "Control-to-observer phase error";
CM_ SG_ 385 PLLSpeedRadS "PLL estimated electrical speed";
CM_ SG_ 385 ObserverFluxVs "Adaptive flux linkage estimate";
CM_ SG_ 385 ObserverAngle "Observer estimated electrical angle";
CM_ BO_ 512 "Motor control commands from test PC. Event-driven.";
CM_ SG_ 512 CmdReserved "Reserved for future extension";
CM_ SG_ 512 CmdRpmRamp "Speed ramp rate override";
CM_ SG_ 512 CmdTargetIqA "Iq current reference";
CM_ SG_ 512 CmdTargetRpm "Speed reference";
CM_ SG_ 512 CmdDirection "+1=Forward, -1=Reverse";
CM_ SG_ 512 CmdControlMode "0=Speed, 1=Current";
CM_ SG_ 512 CmdEnable "0=Stop, 1=Run";
CM_ BO_ 513 "Online calibration parameter write. Event-driven.";
CM_ SG_ 513 CalibApply "0xFF = commit parameters to runtime";
CM_ SG_ 513 CalibFwThreshold "Field weakening voltage threshold";
CM_ SG_ 513 CalibAlignCurrentA "Alignment d-axis current";
CM_ SG_ 513 CalibOpenLoopIqA "Open-loop Iq target";
CM_ SG_ 513 CalibMaxIqA "Maximum Iq clamp";
CM_ SG_ 513 CalibPllKi "PLL integral gain";
CM_ SG_ 513 CalibPllKp "PLL proportional gain";
CM_ SG_ 513 CalibObsGain "Ortega observer correction gain";
CM_ SG_ 513 CalibSpeedKi "Speed PI integral gain";
CM_ SG_ 513 CalibSpeedKp "Speed PI proportional gain";
CM_ SG_ 513 CalibSelector "Parameter group selector (0=speed PI, 1=observer, 2=limits)";
CM_ BO_ 386 "Echo active calibration parameters. Cycle: 200ms.";
CM_ SG_ 386 ActiveHfiAlignHoldMs "Active short align hold after HFI success";
CM_ SG_ 386 ActiveHfiPolarityPulseCount "Active HFI polarity pulse count";
CM_ SG_ 386 ActiveHfiPolarityV "Active HFI polarity pulse voltage";
CM_ SG_ 386 ActiveHfiConfidenceMin "Active HFI confidence threshold";
CM_ SG_ 386 ActiveHfiInjectV "Active HFI bipolar injection voltage";
CM_ SG_ 386 ActiveHfiPulsePairs "Active HFI pulse pairs per candidate";
CM_ SG_ 386 ActiveHfiCandidateCount "Active HFI coarse candidate count";
CM_ SG_ 386 ActiveHfiFlags "Bit0=HFI/IPD enabled";
CM_ SG_ 386 WaveformSampleCount "Number of waveform samples captured";
CM_ SG_ 386 WaveformState "0=Idle,1=Capturing,2=Sending,3=Done";
CM_ SG_ 386 ActiveCurrentIqKi "Active Q-axis current PI Ki";
CM_ SG_ 386 ActiveCurrentIqKp "Active Q-axis current PI Kp";
CM_ SG_ 386 ActiveCurrentIdKi "Active D-axis current PI Ki";
CM_ SG_ 386 ActiveCurrentIdKp "Active D-axis current PI Kp";
CM_ SG_ 386 ActiveRpmRamp "Active speed ramp rate";
CM_ SG_ 386 ActiveFwThreshold "Active FW voltage threshold";
CM_ SG_ 386 ActiveAlignCurrentA "Active alignment current";
CM_ SG_ 386 ActiveOpenLoopIqA "Active open-loop Iq";
CM_ SG_ 386 ActiveMaxIqA "Active Iq clamp";
CM_ SG_ 386 ActivePllKi "Active PLL Ki";
CM_ SG_ 386 ActivePllKp "Active PLL Kp";
CM_ SG_ 386 ActiveObsGain "Active observer gain";
CM_ SG_ 386 ActiveSpeedKi "Active speed PI Ki";
CM_ SG_ 386 ActiveSpeedKp "Active speed PI Kp";
CM_ BO_ 387 "PWM-rate waveform burst data. Sent after TestCommand trigger.";
CM_ SG_ 387 WfCh6_ElecAngle "Electrical angle";
CM_ SG_ 387 WfCh5_Iq "Q-axis current";
CM_ SG_ 387 WfCh4_Id "D-axis current";
CM_ SG_ 387 WfCh3_Vbus "DC bus voltage";
CM_ SG_ 387 WfCh2_Ic "Phase C current";
CM_ SG_ 387 WfCh1_Ib "Phase B current";
CM_ SG_ 387 WfCh0_Ia "Phase A current";
CM_ SG_ 387 WfDecimation "Decimation factor (sample every N ticks)";
CM_ SG_ 387 WfTriggerSource "Trigger: 0=none,1=manual,2=startup,3=fault";
CM_ SG_ 387 WfTotalSamples "Total samples in this capture";
CM_ SG_ 387 WfSampleIndex "Current sample index in burst";
CM_ BO_ 514 "Test command from PC. Event-driven.";
CM_ SG_ 514 TcHfiAlignHoldMs "Short align hold after HFI success";
CM_ SG_ 514 TcHfiPolarityPulseCount "Polarity comparison pulse count";
CM_ SG_ 514 TcHfiPolarityV "Polarity comparison pulse voltage";
CM_ SG_ 514 TcHfiConfidenceMin "Minimum acceptable HFI confidence";
CM_ SG_ 514 TcHfiInjectV "Bipolar HFI injection voltage";
CM_ SG_ 514 TcHfiPulsePairs "+/- pulse pairs per candidate";
CM_ SG_ 514 TcHfiCandidateCount "Coarse candidate count over [0,pi)";
CM_ SG_ 514 TcHfiEnable "0=disable, non-zero=enable static HFI/IPD";
CM_ SG_ 514 TcStepDecimation "Step decimation factor";
CM_ SG_ 514 TcStepInjectIdA "Step D-axis current injection";
CM_ SG_ 514 TcStepPostSamples "Step post-trigger samples";
CM_ SG_ 514 TcStepPreSamples "Step pre-trigger samples";
CM_ SG_ 514 TcIdentIqStepA "Lambda Iq retry increment";
CM_ SG_ 514 TcIdentIqMaxA "Lambda Iq max current";
CM_ SG_ 514 TcIdentIqMinA "Lambda Iq initial current";
CM_ SG_ 514 TcIdentTestCurrentA "Rs/Ls test current";
CM_ SG_ 514 TcIdentTargetRpm "Target mechanical RPM for lambda ident";
CM_ SG_ 514 TcIdentPolePairs "Motor pole pairs (for cmd 0x20)";
CM_ SG_ 514 TcTriggerSource "Trigger source for capture";
CM_ SG_ 514 TcDecimation "Decimation factor";
CM_ SG_ 514 TcNSamples "Number of samples to capture";
CM_ SG_ 514 TcCommandType "0x01=CaptureStart,0x02=Abort,0x03=Send,0x10=ResetCurrentPI,0x20=StartParamIdent,0x21=AbortParamIdent,0x30=StartAngleMonitor,0x31=StopAngleMonitor,0x32=ConfigHFI";

SIG_VALTYPE_ 385 IdentRsOhm : 1;
SIG_VALTYPE_ 385 IdentLsH : 1;
SIG_VALTYPE_ 385 IdentLambdaVs : 1;
SIG_VALTYPE_ 513 CalibSpeedKp : 1;
SIG_VALTYPE_ 513 CalibSpeedKi : 1;
SIG_VALTYPE_ 513 CalibObsGain : 1;
SIG_VALTYPE_ 513 CalibPllKp : 1;
SIG_VALTYPE_ 513 CalibPllKi : 1;
SIG_VALTYPE_ 386 ActiveSpeedKp : 1;
SIG_VALTYPE_ 386 ActiveSpeedKi : 1;
SIG_VALTYPE_ 386 ActiveObsGain : 1;
SIG_VALTYPE_ 386 ActivePllKp : 1;
SIG_VALTYPE_ 386 ActivePllKi : 1;
SIG_VALTYPE_ 386 ActiveCurrentIdKp : 1;
SIG_VALTYPE_ 386 ActiveCurrentIdKi : 1;
SIG_VALTYPE_ 386 ActiveCurrentIqKp : 1;
SIG_VALTYPE_ 386 ActiveCurrentIqKi : 1;
SIG_VALTYPE_ 387 WfCh0_Ia : 1;
SIG_VALTYPE_ 387 WfCh1_Ib : 1;
SIG_VALTYPE_ 387 WfCh2_Ic : 1;
SIG_VALTYPE_ 387 WfCh3_Vbus : 1;
SIG_VALTYPE_ 387 WfCh4_Id : 1;
SIG_VALTYPE_ 387 WfCh5_Iq : 1;
SIG_VALTYPE_ 387 WfCh6_ElecAngle : 1;
SIG_VALTYPE_ 514 TcIdentTargetRpm : 1;
SIG_VALTYPE_ 514 TcIdentTestCurrentA : 1;
SIG_VALTYPE_ 514 TcIdentIqMinA : 1;
SIG_VALTYPE_ 514 TcIdentIqMaxA : 1;
SIG_VALTYPE_ 514 TcIdentIqStepA : 1;
SIG_VALTYPE_ 514 TcStepInjectIdA : 1;

BA_DEF_ "BusType" STRING;
BA_ "BusType" "CAN FD";
